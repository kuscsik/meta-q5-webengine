## conf/layer.conf
```bitbake
BBPATH .= ":${LAYERDIR}"

BBFILES += "${LAYERDIR}/recipes-*/*/*.bb ${LAYERDIR}/recipes-*/*/*.bbappend"

BBFILE_COLLECTIONS += "qt5-webengine-layer"
BBFILE_PATTERN_qt5-webengine-layer := "^${LAYERDIR}/"
BBFILE_PRIORITY_qt5-webengine-layer = "7"
```
